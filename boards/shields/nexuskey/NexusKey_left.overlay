#include "NexusKey.dtsi"

/ {
    chosen {
        zmk,kscan = &kscan0;
    };

    kscan0: kscan {
        compatible = "zmk,kscan-gpio-matrix";
        wakeup-source;  // For Deep Sleep

        diode-direction = "col2row";

        row-gpios
            = <&gpio1 2 (GPIO_ACTIVE_HIGH | GPIO_PULL_DOWN)>    // P1.02
            , <&gpio0 2 (GPIO_ACTIVE_HIGH | GPIO_PULL_DOWN)>    // P0.02
            , <&gpio0 28 (GPIO_ACTIVE_HIGH | GPIO_PULL_DOWN)>   // P0.28
            ;

        col-gpios
            = <&gpio1 0 GPIO_ACTIVE_HIGH>   // P1.00
            , <&gpio0 22 GPIO_ACTIVE_HIGH>  // P0.22
            , <&gpio1 3 GPIO_ACTIVE_HIGH>   // P1.03
            , <&gpio0 31 GPIO_ACTIVE_HIGH>  // P0.31
            , <&gpio0 30 GPIO_ACTIVE_HIGH>  // P0.30
            , <&gpio1 13 GPIO_ACTIVE_HIGH>  // P1.13
            ;
    };
};

// Soft Off Behavior

/ {
    // Attach the keys device to wake up sources so it can turn on the keyboard.

    wakeup_source: wakeup_source {
        compatible = "zmk,gpio-key-wakeup-trigger";
        trigger = <&soft_off_key>;
        extra-gpios
        = <&gpio1 0 (GPIO_ACTIVE_HIGH | GPIO_PULL_UP)>
        , <&gpio0 30 (GPIO_ACTIVE_HIGH | GPIO_PULL_UP)>
        ;
        wakeup-source;
    };
};
