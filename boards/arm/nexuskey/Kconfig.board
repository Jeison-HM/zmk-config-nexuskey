## boards/arm/nexuskey/Kconfig.board
```kconfig
# NexusKey board configuration

config BOARD_NEXUSKEY
    bool "NexusKey"
    depends on SOC_NRF52840_QIAA
```

## boards/arm/nexuskey/Kconfig.defconfig
```kconfig
if BOARD_NEXUSKEY

config BOARD
    default "NexusKey"

if USB_DEVICE_STACK

config USB_NRFX
    default y

endif # USB_DEVICE_STACK

config BT_CTLR
    default BT

endif # BOARD_NEXUSKEY
```

## boards/shields/nexuskey/Kconfig.defconfig
```kconfig
if SHIELD_NEXUSKEY_LEFT

config ZMK_KEYBOARD_NAME
    default "NexusKey"

endif # SHIELD_NEXUSKEY_LEFT
```

## boards/shields/nexuskey/Kconfig.shield
```kconfig
config SHIELD_NEXUSKEY_RIGHT
    def_bool $(shields_list_contains,NexusKey_right)
```
